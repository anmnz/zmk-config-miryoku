## config/west.yml
```yaml
manifest:
  defaults:
    revision: v0.3
  remotes:
    - name: zmkfirmware
      url-base: https://github.com/zmkfirmware
    - name: ergomechstore
      url-base: https://github.com/ergomechstore
    - name: manna-harbour
      url-base: https://github.com/manna-harbour
  projects:
    - name: zmk
      remote: zmkfirmware
      import: app/west.yml
    - name: sofle-hybrid-ergomech-zmk
      remote: ergomechstore
      revision: master
      path: modules/sofle-hybrid-ergomech-zmk
    - name: miryoku_zmk
      remote: manna-harbour
      revision: master
      path: modules/miryoku_zmk
  self:
    path: config
```
